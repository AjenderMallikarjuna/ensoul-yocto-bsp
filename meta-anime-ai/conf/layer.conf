## meta-anime-ai/conf/layer.conf
```bitbake
BBPATH .= ":${LAYERDIR}"
BBFILES += "${LAYERDIR}/recipes-*/*/*.bb ${LAYERDIR}/recipes-*/*/*.bbappend"

BBFILE_COLLECTIONS += "anime-ai"
BBFILE_PATTERN_anime-ai = "^${LAYERDIR}/"
BBFILE_PRIORITY_anime-ai = "6"

LAYERSERIES_COMPAT_anime-ai = "scarthgap"
```
